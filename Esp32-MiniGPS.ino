// 05/12/2021 :)

// Bibliotecas
#include <Wire.h>
#include <Time.h>
#include <TimeLib.h>
#include <TinyGPS++.h>
#include <SoftwareSerial.h>
#include <Adafruit_SSD1306.h>
#include <SPIFFS.h>
#include <FS.h>

#define LOGFILE "/log.txt"
boolean newData = false;

// Buzzer
#define buzzer 18

// Botões
#define menu 5
#define enter 4
int key = 0;
int leitura;

// Variaveis
double Lat;
double Long;
double Alt;
int sat, gps_speed;
char input = 0;
int max_spd = 0;

const int UTC_offset = -3;
time_t prevDisplay = 0;

// Para ESP32: GPIO-21(SDA), GPIO-22(SCL)
#define SCREEN_WIDTH 128
#define SCREEN_HEIGHT 64
#define OLED_RESET -1
#define SCREEN_ADDRESS 0x3C
Adafruit_SSD1306 display(SCREEN_WIDTH, SCREEN_HEIGHT, &Wire, OLED_RESET);

// Configurações do GPS
static const int RXPin = 16, TXPin = 17;
static const uint32_t GPSBaud = 9600;
TinyGPSPlus gps;
SoftwareSerial ss(RXPin, TXPin);

// Configurações de Distance_To_Home
const double Home_LAT = -00.0000000; //Lat da sua casa
const double Home_LNG = -00.0000000; //Lng da sua casa
const float rad_fac = 0.017453292;
int x = 0;
int y = 0;
int i = 0;
int j = 0;
double courseTo = 0;
double relCourse = 0;
double courseHome = 0;
unsigned long Distance_To_Home = 0;
unsigned long Trip_distance = 0;

// Configuração de Trip
double Trip_LAT = 0;
double Trip_LNG = 0;

const unsigned char gps_sial[] PROGMEM = {
    0x1e, 0x00, 0x33, 0x00, 0x4c, 0x80, 0x52, 0x40, 0xa5, 0x40, 0xad, 0x40, 0x53, 0x40, 0x40, 0x80,
    0x21, 0x80, 0x00, 0x00};

const unsigned char reco[] PROGMEM = {
    0x00, 0x00, 0x1e, 0x00, 0x33, 0x00, 0x61, 0x80, 0x40, 0x80, 0x40, 0x80, 0x61, 0x80, 0x33, 0x00,
    0x1e, 0x00, 0x00, 0x00};

const unsigned char gps_loading[] PROGMEM = {
    0x00, 0x00, 0x00, 0x00, 0x00, 0x0f, 0xc0, 0x00, 0x00, 0x7f, 0xf8, 0xc0, 0x01, 0xf0, 0x3e, 0xc0,
    0x03, 0x80, 0x07, 0xc0, 0x07, 0x00, 0x03, 0xc0, 0x0e, 0x00, 0x0f, 0xc0, 0x1c, 0x00, 0x0f, 0xc0,
    0x18, 0x00, 0x00, 0x00, 0x30, 0x00, 0x00, 0x00, 0x30, 0x00, 0x00, 0x00, 0x30, 0x00, 0x00, 0x10,
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    0x00, 0x0f, 0xc0, 0x00, 0x00, 0x00, 0x00, 0x00};

const unsigned char logo[] PROGMEM = {
    0x00, 0x00, 0x00, 0x00, 0x00, 0x00, 0x00, 0x00, 0x00, 0x00, 0x00, 0x00, 0x00, 0x00, 0x00, 0x00,
  0x00, 0x00, 0x00, 0x00, 0x00, 0x00, 0x00, 0x00, 0x00, 0x00, 0x00, 0x00, 0x00, 0x00, 0x00, 0x00,
  0x00, 0x00, 0x00, 0x00, 0x00, 0x00, 0x00, 0x00, 0x00, 0x00, 0x00, 0x00, 0x00, 0x00, 0x00, 0x00,
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  0x00, 0x00, 0x00, 0x00, 0x00, 0x00, 0x00, 0x00, 0x00, 0x00, 0x00, 0x00, 0x00, 0x00, 0x00, 0x00};

void setup()
{
  Serial.begin(9600);

  ss.begin(GPSBaud);

  pinMode(menu, INPUT_PULLUP);
  pinMode(enter, INPUT_PULLUP);
  pinMode(buzzer, OUTPUT);

  if (!display.begin(SSD1306_SWITCHCAPVCC, SCREEN_ADDRESS))
  {
    Serial.println(F("SSD1306 allocation failed"));
  }

  SPIFFS.begin();

  // Isso abre o arquivo "log.txt" em modo de leitura
  File f = SPIFFS.open(LOGFILE, "r");

  if (!f)
  {
    Serial.print("O arquivo ainda não existe.\n Formatando e criando...");
    SPIFFS.format();

    File f = SPIFFS.open(LOGFILE, "w");
    if (!f)
    {
      Serial.println("Falha na criação do arquivo!");
    }
  }
  f.close();

  if (digitalRead(enter) == LOW)
  {
    File f = SPIFFS.open(LOGFILE, "w");
    Serial.print(f.readString());
    Serial.println("Logs Apagados!!");
    f.close();

    digitalWrite(buzzer, HIGH);
    delay(200);
    digitalWrite(buzzer, LOW);
    delay(200);
  }
  display.clearDisplay();
  display.drawBitmap(0, 0, logo, 128, 64, 1);
  display.display();
  delay(4000);
}

void Get_GPS()
{
  while (ss.available())
    gps.encode(ss.read());

  sat = gps.satellites.value();
  if (gps.location.isValid() == 1)
  {
    Lat = gps.location.lat();
    Long = gps.location.lng();
    Alt = gps.altitude.meters();
    gps_speed = gps.speed.kmph();

    courseTo = TinyGPSPlus::courseTo(Lat, Long, Trip_LAT, Trip_LNG);

    courseHome = TinyGPSPlus::courseTo(Lat, Long, Home_LAT, Home_LNG);

    Distance_To_Home = (unsigned long)TinyGPSPlus::distanceBetween(gps.location.lat(), gps.location.lng(), Home_LAT, Home_LNG);

    relCourse = courseHome - gps.course.deg();

    Trip_distance = (unsigned long)TinyGPSPlus::distanceBetween(gps.location.lat(), gps.location.lng(), Trip_LAT, Trip_LNG);
  }
}

void gps_home()
{
  while (ss.available())
  {
    if (gps.encode(ss.read()))
    {
      if (gps.location.isValid() == 1)
      {
        int Year = gps.date.year();
        byte Month = gps.date.month();
        byte Day = gps.date.day();
        byte Hour = gps.time.hour();
        byte Minute = gps.time.minute();
        byte Second = gps.time.second();

        setTime(Hour, Minute, Second, Day, Month, Year);
        adjustTime(UTC_offset * SECS_PER_HOUR);

        if (timeStatus() != timeNotSet)
        {
          if (now() != prevDisplay)
          {
            prevDisplay = now();

            char hora[32];
            sprintf(hora, "%02d:%02d", hour(), minute());

            char data[32];
            sprintf(data, "%02d/%02d", day(), month());

            char satl[32];
            sprintf(satl, "%02d", sat);

            String cardinalTo = TinyGPSPlus::cardinal(courseTo);

            display.clearDisplay();
            display.drawLine(0, 12, 128, 12, WHITE);
            display.setTextSize(1);
            display.setCursor(0, 1);
            display.print(hora);
            display.setCursor(50, 1);
            display.print(data);
            display.drawBitmap(102, 0, gps_sial, 10, 10, 1);
            display.setCursor(116, 1);
            display.print(satl);

            display.setTextSize(1);
            display.setCursor(0, 15);
            display.print("Latitude  : ");
            display.println(Lat, 5);
            display.print("Longitude : ");
            display.println(Long, 4);
            display.print("Altitude  : ");
            display.println(Alt, 0);
            display.print("Cardinal  : ");
            display.println(cardinalTo);
            display.print("Speed     : ");
            display.println(gps_speed);

            display.print("Home      : ");
            display.print(Distance_To_Home / 1000, 2);
            display.print("km");

            if (newData == true)
            {
              display.drawBitmap(90, 0, reco, 10, 10, 1);

              File f = SPIFFS.open(LOGFILE, "a");
              f.print(Lat, 5);
              f.print(", ");
              f.println(Long, 4);
              f.close();
            }
            display.display();
          }
        }
      }
      else
      {
        display.clearDisplay();
        display.drawLine(0, 12, 128, 12, WHITE);
        display.setTextSize(1);
        display.setCursor(0, 0);
        display.print("00:00");
        display.setCursor(50, 1);
        display.print("00/00");
        display.drawBitmap(102, 0, gps_sial, 10, 10, 1);
        display.setCursor(116, 1);
        display.print("00");
        display.drawBitmap(49, 21, gps_loading, 30, 30, 1);
        display.setCursor(30, 55);
        display.print("Carregando...");
        display.display();
      }
    }
  }
}

void gps_speedometer()
{
  char vel[32];
  sprintf(vel, "%03d", gps_speed);

  char satl[32];
  sprintf(satl, "%02d", sat);

  display.clearDisplay();
  display.setTextSize(1);
  display.drawLine(0, 12, 128, 12, WHITE);
  display.setCursor(0, 1); // 35 CENTRO
  display.print("VELOCIDADE");
  display.drawBitmap(102, 0, gps_sial, 10, 10, 1);
  display.setCursor(116, 1);
  display.print(satl);
  display.setTextSize(2);
  display.setCursor(48, 30);
  display.print(vel);
  display.setTextSize(1);
  display.print(" KM/H");

  if (max_spd < gps_speed)
  {
    max_spd = gps_speed;
  }

  if (digitalRead(enter) == LOW)
  {
    max_spd = 0;

    digitalWrite(buzzer, HIGH);
    delay(300);
    digitalWrite(buzzer, LOW);
  }

  display.setTextSize(1);
  display.setCursor(0, 57);
  display.print("MAX: ");
  display.print(max_spd);
  display.print("km/h");
  display.display();
}

void gps_trip()
{
  char satl[32];
  sprintf(satl, "%02d", sat);

  String cardinalTo = TinyGPSPlus::cardinal(courseTo);

  if (digitalRead(enter) == LOW)
  {
    Trip_LAT = Lat;
    Trip_LNG = Long;

    digitalWrite(buzzer, HIGH);
    delay(300);
    digitalWrite(buzzer, LOW);
  }

  display.clearDisplay();
  display.setTextSize(1);
  display.drawLine(0, 12, 128, 12, WHITE);
  display.setCursor(0, 1); // 35 CENTRO
  display.print("TRIP");
  display.drawBitmap(102, 0, gps_sial, 10, 10, 1);
  display.setCursor(116, 1);
  display.print(satl);

  if (Trip_LAT == 0)
  {
    display.setTextSize(2);
    display.setCursor(0, 15);
    display.print("0");
    display.setTextSize(1);
    display.print(":M");

    display.setTextSize(2);
    display.setCursor(0, 32);
    display.print("0");
    display.setTextSize(1);
    display.print(":Curso");

    display.setTextSize(2);
    display.setCursor(0, 49);
    display.print("0");
    display.setTextSize(1);
    display.print(":Cardinal");
  }
  else
  {
    display.setTextSize(2);
    display.setCursor(0, 15);
    display.print(Trip_distance);
    display.setTextSize(1);
    display.print(":M");

    display.setTextSize(2);
    display.setCursor(0, 32);
    display.print(courseTo);
    display.setTextSize(1);
    display.print(":Curso");

    display.setTextSize(2);
    display.setCursor(0, 49);
    display.print(cardinalTo);
    display.setTextSize(1);
    display.print(":Cardinal");
  }
  display.display();
}

void Home_trip()
{
  char satl[32];
  sprintf(satl, "%02d", sat);

  if (relCourse < 0)
  {
    relCourse = relCourse + 360;
  }
  if (relCourse >= 360)
  {
    relCourse = relCourse - 360;
  }
  if (Distance_To_Home < 0)
  { // Mais perto de 25 metros é a casa
    display.clearDisplay();
    display.drawCircle(25, 40, 8, WHITE);
    display.setTextSize(1);
    display.drawLine(0, 12, 128, 12, WHITE);
    display.setCursor(0, 1); // 35 CENTRO
    display.print("HOME");
    display.drawBitmap(102, 0, gps_sial, 10, 10, 1);
    display.setCursor(116, 1);
    display.print(satl);
  }
  else
  {
    display.clearDisplay();
    display.setTextSize(1);
    display.drawLine(0, 12, 128, 12, WHITE);
    display.setCursor(0, 1); // 35 CENTRO
    display.print("HOME");
    display.drawBitmap(102, 0, gps_sial, 10, 10, 1);
    display.setCursor(116, 1);
    display.print(satl);

    if (gps.location.isValid() == 1)
    {
      display.drawCircle(25, 40, 23, WHITE);
      x = (sin(relCourse * rad_fac) * 21);
      y = (cos(relCourse * rad_fac) * 21);
      int x1 = 25 + x;
      int y1 = 40 - y;
      int x2 = 25 - x;
      int y2 = 40 + y;
      display.drawLine(x1, y1, x2, y2, WHITE);
      double arrowAngle = relCourse + 225; // Ângulo de abertura de 90 graus da ponta da seta
      x = (sin(arrowAngle * rad_fac) * 10);
      y = (cos(arrowAngle * rad_fac) * 10);
      x2 = x1 + x;
      y2 = y1 - y;
      display.drawLine(x1, y1, x2, y2, WHITE);
      arrowAngle = relCourse + 135;
      x = (sin(arrowAngle * rad_fac) * 10);
      y = (cos(arrowAngle * rad_fac) * 10);
      x2 = x1 + x;
      y2 = y1 - y;
      display.drawLine(x1, y1, x2, y2, WHITE);
    }
    else
    {
      x = 8;
      y = 8;
      int x1 = 25 + x;
      int y1 = 40 - y;
      int x2 = 25 - x;
      int y2 = 40 + y;
      display.drawLine(x1, y1, x2, y2, WHITE);
      x1 = 25 + x;
      y1 = 40 + y;
      x2 = 25 - x;
      y2 = 40 - y;
      display.drawLine(x1, y1, x2, y2, WHITE);
    }
    display.setCursor(54, 24);
    display.print("Head: ");
    display.print(relCourse, 0);
    display.setCursor(54, 33);
    display.print("Crse: ");
    display.print(courseTo);
    display.setCursor(54, 42);
    display.print("Dis: ");
    display.print(Distance_To_Home / 1000, 2);
    display.print("km");
    display.setCursor(54, 51);
    display.print("Spd: ");
    display.print(gps_speed);
    display.print("km/h");
  }
  display.display();
}

void loop()
{
  Get_GPS();
  display.clearDisplay();
  display.setTextColor(SSD1306_WHITE);

  if (digitalRead(menu) == LOW)
  {
    key = (key + 1);
    delay(200);
  }

  if (key < 0 or key > 3)
  {
    key = 0;
  }

  if (Serial.available() > 0)
  {
    input = Serial.read();

    if (input == 'l')
    {
      File f = SPIFFS.open(LOGFILE, "r");
      Serial.print(f.readString());
      Serial.println("Fim!!");
      f.close();
    }
    if (input == 'a')
    {
      File f = SPIFFS.open(LOGFILE, "w");
      Serial.print(f.readString());
      Serial.println("Logs Apagados!!");
      f.close();
    }
  }

  switch (key)
  {
  case 0:
  {
    gps_home();

    if (digitalRead(enter) == LOW)
    {
      if (gps.location.isValid() == 1)
      {
        if (newData != false)
        {
          newData = false;
        }
        else
        {
          newData = true;
        }
        digitalWrite(buzzer, HIGH);
        delay(300);
        digitalWrite(buzzer, LOW);
      }
    }
  }
  break;

  case 1:
  {
    gps_speedometer();
  }
  break;

  case 2:
  {
    gps_trip();
  }
  break;

  case 3:
  {
    Home_trip();
  }
  break;
  }
}
